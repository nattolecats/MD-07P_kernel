/*mono dtsi config*/
&i2c6 {
/* OCS OCA72XXX Smart K PA */
	oca72xxx_pa@58 {
		compatible = "ocs,oca72xxx_pa";
		reg = <0x58>;
		/*	reset-gpio = <&pio 1 0>; oca72390没有reset，oca72559需要打开*/
		dev_index = < 0 >;
		status = "okay";
	};
/* OCS OCA72XXX Smart K PA End */
};
