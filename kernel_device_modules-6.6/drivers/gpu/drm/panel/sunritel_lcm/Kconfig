## kernel_device_modules-6.6/drivers/leds/Kconfig
```kconfig
# SPDX-License-Identifier: GPL-2.0-only

if NEW_LEDS

config DEVICE_MODULES_LEDS_MT6360
	tristate "LED Support for Mediatek MT6360 PMIC"
	depends on LEDS_CLASS_FLASH && OF
	depends on V4L2_FLASH_LED_CLASS || !V4L2_FLASH_LED_CLASS
	depends on DEVICE_MODULES_MFD_MT6360
	help
	  This option enables support for dual Flash LED drivers found on
	  Mediatek MT6360 PMIC.
	  Support Torch and Strobe mode independently current source.
	  Include Low-VF and short protection.

config LEDS_MT6362
	tristate "MT6362 SPMI LEDS driver"
	depends on LEDS_CLASS_FLASH && OF
	depends on V4L2_FLASH_LED_CLASS || !V4L2_FLASH_LED_CLASS
	depends on REGULATOR_MT6362
	help
	  Say yes here to have support for the MT6362 LEDS
	  Provide strobe and torch mode with flashlight, and
	  indicator and moonlight with rgbled.

	  The driver can also be build as a module.
	  If so, the module will be called leds_mt6362

config MTK_SUPPORT_AW2016
	tristate "aw2016 Support"
	depends on LEDS_CLASS
	help
	  RGB LED driver for aw2016 support.
	  Set y to support. Set n to disable.

config ST_LEDS_MT6370_RGB
	tristate "LED Support for MediaTek MT6370 PMIC"
	depends on DEVICE_MODULES_MFD_MT6370
	select LINEAR_RANGES
	help
	  Say Y here to enable support for MT6370_RGB LED device.
	  In MT6370, there are four channel current-sink LED drivers that
	  support hardware pattern for constant current, PWM, and breath mode.
	  Isink4 channel can also be used as a CHG_VIN power good indicator.

	  This driver can also be built as a module. If so, the module
	  will be called "leds-mt6370-rgb".
	  
config ST_LEDS_MT6370_BLED
	tristate "MediaTek MT6370 Backlight Driver"
	depends on DEVICE_MODULES_MFD_MT6370
	help
	  This enables support for Mediatek MT6370 Backlight driver.
	  It's commonly used to drive the display WLED. There are 4 channels
	  inside, and each channel supports up to 30mA of current capability
	  with 2048 current steps (only for MT6370/MT6371) or 16384 current 
	  steps (only for MT6372) in exponential or linear mapping curves.
		
	  This driver can also be built as a module. If so, the module
	  will be called "mt6370-backlight".	  

config LEDS_MTK
	tristate "Mediatek COMMON LED support"
	depends on LEDS_CLASS
	help
	  This option enables support for Mediatek common LEDs
	  say 'y' to enable this

	  To compile this driver as a module, choose 'M' here: the module
	  will be called leds-mtk.

config LEDS_MTK_PWM
	tristate "Mediatek pwm LED support"
	depends on LEDS_CLASS && LEDS_MTK
	depends on DEVICE_MODULES_PWM_MTK_DISP
	help
	  This option enables support for Mediatek pwm LEDs.
	  say 'y' to enable this

	  To compile this driver as a module, choose 'M' here: the module
	  will be called leds-mtk-pwm.

config LEDS_MTK_DISP
	tristate "Mediatek DISP LED support"
	depends on LEDS_CLASS && LEDS_MTK
	depends on MTK_CMDQ_MBOX_EXT
	help
	  This option enables support for Mediatek OLED Display LEDs
	  say 'y' to enable this

	  To compile this driver as a module, choose 'M' here: the module
	  will be called leds-mtk-disp.

config LEDS_MT_BRIGHTNESS_HW_CHANGED
	bool "LED Class mt_brightness_hw_changed attribute support"
	depends on LEDS_CLASS
	help
	  This option enables support for the mt_brightness_hw_changed attribute
	  for LED sysfs class devices under /sys/class/leds.

	  See Documentation/ABI/testing/sysfs-class-led for details
	  this function is the same with brightness_hw_changed


config LEDS_REGULATOR_VIBRATOR
	tristate "LED regulator vibrator support"
	depends on LEDS_CLASS
	help
	  This option enables support for LED regulator vibrator.
	  say 'y' to enable this

	  To compile this driver as a module, choose 'M' here: the module
	  will be called regulator-vibrator.

comment "Flash and Torch LED drivers"
source "$(KCONFIG_EXT_PREFIX)drivers/leds/flash/Kconfig"

endif # NEW_LEDS
```

## kernel_device_modules-6.6/drivers/misc/mediatek/aw9523b/Kconfig
```kconfig
config AW9523B
	tristate "aw9523b driver spec"
	help
		say Y to enable aw9523b driver spec.
		

	
```

## kernel_device_modules-6.6/drivers/misc/mediatek/dummy_camera/Kconfig
```kconfig
config SUNRITEL_DCAM
	tristate "SUNRITEL_DCAM  driver solution"
	help
	  SUNRITEL_DCAM Near Field Communication controller support.
	  It is the master switch of SUNRITEL_DCAM  controller drivers.
	  If configures to be y, SUNRITEL_DCAM and SUNRITEL_DCAM will be
	  selected.
```

## kernel_device_modules-6.6/drivers/misc/mediatek/exp_module/Kconfig
```kconfig
config MTK_EXP_MODULE
	tristate "Enable exp_module driver"
	help
	  If configures to be y, means devices supports exp_module functionality. 
	  If configures to be n, means devices doesn't support
	  exp_module functionality.
```

## kernel_device_modules-6.6/drivers/misc/mediatek/fingerprint/Kconfig
```kconfig
config MTK_FINGERPRINT_SUPPORT
	tristate "STMicroelectronics NFC driver solution"
	help
	  STMicroelectronics Near Field Communication controller support.
	  It is the master switch of STMicroelectronics NFC controller drivers.
	  If configures to be y, FORTSENSE_FP and NFC_ST54_SPI will be
	  selected.


config FOCALTECH_FINGERPRINT
	bool "FocalTech FingerPrint"
	default n
	help
	the FocalTech's fingerprint sensor.

config FOCALTECH_FINGERPRINT9391
	tristate "FocalTech FingerPrint"
	help
	the FocalTech's fingerprint sensor.
	
config SILEAD_FP
	tristate "SILEAD_FP driver solution"
	help
	  STMicroelectronics FORTSENSE Near Field Communication controller
	  support. FORTSENSE is standalone NFC and ST54 is combined with secure
	  element. If configures to be y, means devices supports NFC
	  functionality. If configures to be n, means devices doesn't support
	  NFC functionality.	  
config GOODIX_FINGERPRINT
	tristate "Goodix Fingerprint"
	default n
	help
	  Goodix Fingerprint chip GF316M/GF318M/
	  GF3118M/GF518M/GF5118M/GF516M/GF816M/
	  GF3208/GF3206/GF3266/GF3288/GF5206/
	  GF5216/GF5208 TEE driver
source "$(KCONFIG_EXT_PREFIX)drivers/misc/mediatek/fingerprint/focaltech_fp/Kconfig"
source "$(KCONFIG_EXT_PREFIX)drivers/misc/mediatek/fingerprint/focaltech_fp9391/Kconfig"
source "$(KCONFIG_EXT_PREFIX)drivers/misc/mediatek/fingerprint/silead/Kconfig"
source "$(KCONFIG_EXT_PREFIX)drivers/misc/mediatek/fingerprint/microarray_fp_tee/Kconfig"
```

## kernel_device_modules-6.6/drivers/misc/mediatek/fingerprint/microarray_fp_tee/Kconfig
```kconfig
# Copyright (C) MicroArray  
# MicroArray Fprint Driver Code
# Kconfig
# Date: 2017-3-15
# Version: v4.0.06
# Author: guq
# Contact: guq@microarray.com.cn

config MICROARRAY_FINGERPRINT_TEE
	tristate "MICROARRAY Fingerprint TEE"
	help
	  This supports microarray Fingerprint drivers.
```

## kernel_device_modules-6.6/drivers/misc/mediatek/hardwareinfo/Kconfig
```kconfig
config MTK_HARDWAREINFO
        tristate "MTK_HARDWAREINFO"
        default n
        help
          This will enable MTK_HARDWAREINFO
          If you say Y, enable MTK_HARDWAREINFO
```

## kernel_device_modules-6.6/drivers/misc/mediatek/scannerctrl/Kconfig
```kconfig
config MTK_SCANCAM
	tristate "Enable SCANNERCTRL driver"
	help
	  If configures to be y, means devices supports scannerctrl functionality. 
	  If configures to be n, means devices doesn't support
	  scannerctrl functionality.
```

## kernel_device_modules-6.6/drivers/misc/mediatek/tyhx/Kconfig
```kconfig
config TYHX_SENSORHUB_TEST
	tristate "TYHX_SENSORHUB_TEST driver"
	default n
	help
	  driver for scp test
```

## kernel_device_modules-6.6/drivers/misc/mediatek/wk2xxx/Kconfig
```kconfig
config MTK_WK2XXX
	tristate "Enable WK2XXX driver"
	help
	  If configures to be y, means devices supports wk2124 functionality. 
	  If configures to be n, means devices doesn't support
	  wk2124 functionality.
```

## kernel_device_modules-6.6/drivers/net/usb/Kconfig
```kconfig
# SPDX-License-Identifier: GPL-2.0-only
#
# USB Network devices configuration
#
config USB_RTL8150_KRN
	tristate "USB RTL8150 based ethernet device support"
	select MII
	help
	  Say Y here if you have RTL8150 based usb-ethernet adapter.
	  Send me <petkan@users.sourceforge.net> any comments you may have.
	  You can also check for updates at <http://pegasus2.sourceforge.net/>.

	  To compile this driver as a module, choose M here: the
	  module will be called rtl8150.

config USB_RTL8152_KRN
	tristate "Realtek RTL8152/RTL8153 Based USB Ethernet Adapters"
	select MII
	select CRC32
	select CRYPTO
	select CRYPTO_HASH
	select CRYPTO_SHA256
	help
	  This option adds support for Realtek RTL8152 based USB 2.0
	  10/100 Ethernet adapters and RTL8153 based USB 3.0 10/100/1000
	  Ethernet adapters.

	  To compile this driver as a module, choose M here: the
	  module will be called r8152.
      
config USB_USBNET_KRN
	tristate "Multi-purpose USB Networking Framework"
	select MII
	help
	  This driver supports several kinds of network links over USB,
	  with "minidrivers" built around a common network driver core
	  that supports deep queues for efficient transfers.  (This gives
	  better performance with small packets and at high speeds).

	  The USB host runs "usbnet", and the other end of the link might be:

	  - Another USB host, when using USB "network" or "data transfer"
	    cables.  These are often used to network laptops to PCs, like
	    "Laplink" parallel cables or some motherboards.  These rely
	    on specialized chips from many suppliers.

	  - An intelligent USB gadget, perhaps embedding a Linux system.
	    These include PDAs running Linux (iPaq, Yopy, Zaurus, and
	    others), and devices that interoperate using the standard
	    CDC-Ethernet specification (including many cable modems).

	  - Network adapter hardware (like those for 10/100 Ethernet) which
	    uses this driver framework.

	  The link will appear with a name like "usb0", when the link is
	  a two-node link, or "eth0" for most CDC-Ethernet devices.  Those
	  two-node links are most easily managed with Ethernet Bridging
	  (CONFIG_BRIDGE) instead of routing.

	  For more information see <http://www.linux-usb.org/usbnet/>.

	  To compile this driver as a module, choose M here: the
	  module will be called usbnet.

config USB_NET_AX8817X_KRN
	tristate "ASIX AX88xxx Based USB 2.0 Ethernet Adapters"
	depends on USB_USBNET
	select CRC32
	select PHYLIB
	help
	  This option adds support for ASIX AX88xxx based USB 2.0
	  10/100 Ethernet adapters.

 	  This driver should work with at least the following devices:
	    * Aten UC210T
	    * ASIX AX88172
	    * Billionton Systems, USB2AR
	    * Billionton Systems, GUSB2AM-1G-B
	    * Buffalo LUA-U2-KTX
	    * Corega FEther USB2-TX
	    * D-Link DUB-E100
	    * Hawking UF200
	    * Linksys USB200M
	    * Netgear FA120
	    * Sitecom LN-029
	    * Sitecom LN-028
	    * Intellinet USB 2.0 Ethernet
	    * ST Lab USB 2.0 Ethernet
	    * TrendNet TU2-ET100

	  This driver creates an interface named "ethX", where X depends on
	  what other networking devices you have in use.

config USB_NET_AX88179_178A_KRN
	tristate "ASIX AX88179/178A USB 3.0/2.0 to Gigabit Ethernet"
	depends on USB_USBNET
	select CRC32
	select PHYLIB
	help
	  This option adds support for ASIX AX88179 based USB 3.0/2.0
	  to Gigabit Ethernet adapters.

	  This driver should work with at least the following devices:
	    * ASIX AX88179
	    * ASIX AX88178A
	    * Sitcomm LN-032

	  This driver creates an interface named "ethX", where X depends on
	  what other networking devices you have in use.
      
config USB_NET_DM9601_KRN
	tristate "Davicom DM96xx based USB 10/100 ethernet devices"
	depends on USB_USBNET
	select CRC32
	help
	  This option adds support for Davicom DM9601/DM9620/DM9621A
	  based USB 10/100 Ethernet adapters.
```

## kernel_device_modules-6.6/drivers/sunritel_tools/Kconfig
```kconfig
source "$(KCONFIG_EXT_PREFIX)drivers/sunritel_tools/st_keys/Kconfig"
source "$(KCONFIG_EXT_PREFIX)drivers/sunritel_tools/module_power/Kconfig"
source "$(KCONFIG_EXT_PREFIX)drivers/sunritel_tools/aw9610x/Kconfig"
```

## kernel_device_modules-6.6/drivers/sunritel_tools/aw9610x/Kconfig
```kconfig
#
# Mediatek AW9610X Driver
#
config MTK_AW9610X_SAR
    tristate "MTK_AW9610X_SAR"
	help
	  Say Y here if you have Awinic AW9610X_Sar controller
	  chip in your system.
	  If unsure, say N.
	  To compile this driver as a module, choose M here: the
	  module will be called AW9610X_Sar key.  
```

## kernel_device_modules-6.6/drivers/sunritel_tools/module_power/Kconfig
```kconfig
config MTK_MODULE_POWER_SUPPORT
    tristate "sunritel modules power driver"
    help
      Say Y here to use sunritel modules power ctrl driver.
```

## kernel_device_modules-6.6/drivers/sunritel_tools/st_keys/Kconfig
```kconfig
config SUNRITEL_TOOLS_KEYS_CTRL
    tristate "sunritel keys ctrl driver"
    help
      Say Y here to use sunritel key led driver.
```
